## nRF54/boards/pedal/minimal/Kconfig.minimal
```kconfig
config BOARD_MINIMAL
	select SOC_NRF54L10_CPUAPP if BOARD_MINIMAL_NRF54L10_CPUAPP
```

## nRF54/boards/pedal/minimal/board.yml
```yaml
board:
  name: minimal
  full_name: Guitar pedal, minimal board
  vendor: pedal
  socs:
    - name: nrf54l10
```
