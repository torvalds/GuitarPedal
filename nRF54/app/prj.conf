## CMakeLists.txt
```
cmake_minimum_required(VERSION 3.20.0)

find_package(Zephyr REQUIRED HINTS $ENV{ZEPHYR_BASE})
project(radio)

target_sources(app PRIVATE src/main.c src/pins.c src/audio.c)

if(CONFIG_BT)
	target_sources(app PRIVATE src/midi.c src/scan.c src/bind.c src/sink.c
		src/bcast.c src/unicast.c src/source.c)
endif()
```

## west.yml
```
manifest:
  remotes:
    - name: ncs
      url-base: https://github.com/nrfconnect

  projects:
    - name: nrf
      repo-path: sdk-nrf
      remote: ncs
      revision: b20f8619ba9a5530f8c34b0a130d829947cfe55d
      import:
        name-allowlist:
          - cmsis_6
          - hal_nordic
          - liblc3
          - mbedtls
          - nrfxlib
          - oberon-psa-crypto
          - zephyr
```

## prj.conf
```kconfig
#
# The radio stack is in every image, including the one built with
# CONFIG_BT=n, which does not call bt_enable() and never advertises.
#
# It is here from the start because it is the part most likely to stop
# building for a reason nobody notices: the board has no 32.768 kHz
# crystal, and the low-frequency clock that fact forces is exactly what
# Nordic's protocol timing layer - MPSL - refuses to start without.  A
# build that carries the stack proves that choice every time.
#
# Note that this is not inactive.  MPSL comes up from a SYS_INIT hook at
# PRE_KERNEL_1 priority 40, ahead of the UART driver at 50 and the
# console at 60, so it runs whether or not anything calls into
# Bluetooth - and if it refuses, it does so before there is any way to
# say so.  'make nobt' is the image to reach for when this one says
# nothing at all.
#
CONFIG_BT=y
CONFIG_BT_PERIPHERAL=y
CONFIG_BT_DEVICE_NAME="Pedal"

#
# Replaced at run time by what the pedal says, "Pedal F92A" for one
# board, so that two pedals in one scan can be told apart.  "Pedal" is
# the name until then.
#
CONFIG_BT_DEVICE_NAME_DYNAMIC=y
CONFIG_BT_DEVICE_NAME_MAX=28

#
# There is no console: uart30 is the link to the RP2354, which carries
# packets (src/link.h), and anything written to it raw would break one.
# printk is on, and main.c hooks it, so that each line goes to the pedal
# as a debug packet and comes out of the pedal's debug port.  Reading a
# buffer over SWD instead stalls the core long enough to break what is
# being debugged.
#
# Two banner symbols: the nRF Connect SDK has one of its own and it is
# the one that prints.  It also selects EARLY_CONSOLE.
#
CONFIG_CONSOLE=n
CONFIG_BOOT_BANNER=n
CONFIG_NCS_BOOT_BANNER=n
CONFIG_PRINTK=y

#
# No UART driver.  main.c sets uart30's registers itself, and applies its
# pins from the devicetree through pinctrl, which the driver would
# otherwise have turned on.
#
CONFIG_SERIAL=n
CONFIG_PINCTRL=y

# The audio link from the RP2354 (src/audio.c), and timing it in hardware
CONFIG_I2S=y
CONFIG_NRFX_GPPI=y

#
# LE Audio, exploratory: received (src/sink.c) and sent (src/source.c),
# LC3 at 16 to 48 kHz.
#
# A broadcast sink (src/bcast.c), of two BIS.  It needs a scan delegator
# and published sink capabilities even with no Broadcast Assistant to use
# them.
#
CONFIG_UTF8=y
CONFIG_BT_AUDIO=y
CONFIG_BT_EXT_ADV=y
CONFIG_BT_PER_ADV_SYNC=y
CONFIG_BT_ISO_SYNC_RECEIVER=y
CONFIG_BT_PAC_SNK=y
CONFIG_BT_BAP_SCAN_DELEGATOR=y
CONFIG_BT_BAP_BROADCAST_SINK=y
CONFIG_BT_ISO_RX_BUF_COUNT=8
CONFIG_BT_BAP_BROADCAST_SNK_SUBGROUP_COUNT=1
CONFIG_BT_BAP_BROADCAST_SNK_STREAM_COUNT=2
CONFIG_BT_BAP_BASS_MAX_SUBGROUPS=1
CONFIG_BT_GATT_DYNAMIC_DB=y
CONFIG_BT_AUDIO_CODEC_CFG_MAX_DATA_SIZE=64
CONFIG_BT_AUDIO_CODEC_CFG_MAX_METADATA_SIZE=64
CONFIG_BT_AUDIO_CODEC_CAP_MAX_DATA_SIZE=64
CONFIG_BT_AUDIO_CODEC_CAP_MAX_METADATA_SIZE=64

#
# And a unicast server (src/unicast.c), which is what a phone plays to
# and hears as a headset's microphone (src/source.c): two sink endpoints
# and a source.  CAP acceptor publishes the Common Audio Service.  Two more
# ISO channels, so that a broadcast and a phone do not take each other's.
#
CONFIG_BT_CAP_ACCEPTOR=y
CONFIG_BT_ASCS=y
CONFIG_BT_ISO_PERIPHERAL=y
CONFIG_BT_BAP_UNICAST_SERVER=y
CONFIG_BT_ASCS_MAX_ASE_SNK_COUNT=2
CONFIG_BT_ASCS_MAX_ASE_SRC_COUNT=1
CONFIG_BT_PAC_SRC=y
CONFIG_BT_ISO_TX_BUF_COUNT=2
CONFIG_BT_ATT_PREPARE_COUNT=1
CONFIG_BT_ISO_MAX_CHAN=4

#
# And a unicast client (src/phones.c), the phone's side of LE Audio, for
# headphones: two connections more, since a pair can be a device per ear.
# Room for four of their speaker endpoints - discovery fails outright on
# one there is no room for, and a pair of EarFun buds has four.
#
CONFIG_BT_BAP_UNICAST_CLIENT=y
CONFIG_BT_BAP_UNICAST_CLIENT_ASE_SNK_COUNT=4
CONFIG_BT_BAP_UNICAST_CLIENT_ASE_SRC_COUNT=0
CONFIG_BT_BAP_UNICAST_CLIENT_GROUP_COUNT=1
CONFIG_BT_BAP_UNICAST_CLIENT_GROUP_STREAM_COUNT=2
CONFIG_BT_ISO_CENTRAL=y
CONFIG_BT_GATT_AUTO_DISCOVER_CCC=y
CONFIG_BT_GATT_AUTO_UPDATE_MTU=y

# Their volume, which may be anything they kept from the last device
CONFIG_BT_VCP_VOL_CTLR=y

# The Volume Control Service, which is where a phone sends its volume
CONFIG_BT_VCP_VOL_REND=y

CONFIG_LIBLC3=y
CONFIG_FPU=y

# The main loop decodes and encodes LC3, about 4 kB of stack on its own
CONFIG_MAIN_STACK_SIZE=8192

#
# The hello's boot id is random (src/link.h).  Bluetooth turns the entropy
# driver on as well, but nobt.conf leaves Bluetooth out.
#
CONFIG_ENTROPY_GENERATOR=y

#
# One MIDI packet over Bluetooth is the negotiated MTU minus three, so
# at the default MTU of 23 it is 20 bytes and a 39 kB schema needs two
# thousand of them.  At 247 it is 244.  The ACL buffers carry the L2CAP
# header on top of that.
#
CONFIG_BT_L2CAP_TX_MTU=247
CONFIG_BT_BUF_ACL_RX_SIZE=251
CONFIG_BT_BUF_ACL_TX_SIZE=251

#
# What this radio asks the central for, advertised in the GAP
# characteristic every central reads.
#
# The BLE-MIDI specification asks for a connection interval of 15 ms or
# less and the lowest both ends support; 7.5 ms is the floor Bluetooth
# allows.  Stating a preference here rather than calling
# bt_conn_le_param_update() keeps it out of the connected callback.
#
CONFIG_BT_PERIPHERAL_PREF_MIN_INT=6
CONFIG_BT_PERIPHERAL_PREF_MAX_INT=12
CONFIG_BT_PERIPHERAL_PREF_LATENCY=0
CONFIG_BT_PERIPHERAL_PREF_TIMEOUT=400

#
# +7 dBm, the most the QFN package on this board transmits (the CSP
# package goes to +8); the default is 0.
#
CONFIG_BT_CTLR_TX_PWR_PLUS_7=y

# HCI Read RSSI, which the radio reports as 'rs'
CONFIG_BT_CTLR_CONN_RSSI=y

#
# The radio is a central as well as a peripheral: the web app connects
# to it, and it connects to a foot controller and to headphones.  A scan
# needs only the observer role; the central is for the connections to
# what the player has picked.
#
# BT_MAX_CONN is split by BT_CTLR_SDC_PERIPHERAL_COUNT, and what is left
# over is central roles: two peripheral and four central.  Two peripheral
# connections because an operating system that has paired with the pedal
# holds one of its own, and the web app needs another beside it; two
# central for controllers, and two for the buds of a pair of headphones.
#
CONFIG_BT_CENTRAL=y
CONFIG_BT_OBSERVER=y
CONFIG_BT_GATT_CLIENT=y
CONFIG_BT_MAX_CONN=6
CONFIG_BT_CTLR_SDC_PERIPHERAL_COUNT=2

#
# Bonds that outlive a reset.
#
# Without a settings backend the keys are in RAM, so a host that bonds and
# comes back after the radio has restarted offers a key the radio has
# forgotten - and the radio restarts whenever the pedal does, which is
# every time its power source changes.
#
# ZMS rather than NVS because this part stores in RRAM, which does not need
# erasing before a write and is what ZMS is for; the settings subsystem
# picks the backend from whichever is enabled.  The partition is already
# in the devicetree - 36 kB of 'storage' at 0xf4000 - so there is nothing
# to lay out.
#
# settings_load() has to be called after bt_enable(), and is, in
# midi_ble_start().
#
CONFIG_SETTINGS=y
CONFIG_ZMS=y
CONFIG_FLASH=y
CONFIG_FLASH_MAP=y
CONFIG_BT_SETTINGS=y

#
# Room for a footswitch and more than one host.  It was one, which a
# bonded footswitch took entirely, leaving a host nowhere to go.
#
# A full table overwrites the oldest key that is not in use rather than
# refusing the pairing, because refusing it says nothing to whoever is
# standing there holding the pedal.
#
CONFIG_BT_MAX_PAIRED=4
CONFIG_BT_KEYS_OVERWRITE_OLDEST=y

#
# Pairing.  The controller hangs up during service discovery on a
# connection that was never asked to be encrypted.  It does not answer
# the request either, so nothing waits for a bond - asking is what keeps
# the link up long enough to subscribe.
#
CONFIG_BT_SMP=y

#
# Both of these are on by default in the nRF Connect SDK and both stop
# the pairing dead.
#
# The controller offers legacy pairing only - it answers a request with
# auth_req 0x01, no Secure Connections bit - so SC_PAIR_ONLY refuses it
# and the link drops half a second after the response arrives.  And the
# radio has no keypad and no display, so it can only ever do Just Works,
# which ENFORCE_MITM rules out by definition.
#
# What is left is unauthenticated legacy pairing, which is weak: it is
# open to an eavesdropper who is present while the two are paired.  That
# is the price of this particular footswitch.  The security that matters
# here is which device the pedal will take messages from at all, and
# that is a binding initiated over USB rather than anything SMP does.
#
CONFIG_BT_SMP_SC_PAIR_ONLY=n
CONFIG_BT_SMP_ENFORCE_MITM=n

#
# The hello carries a SHA-256 of the image, worked out at every boot
# (main.c).  The Bluetooth image gets both of these from its stack; the
# nobt image has to ask.
#
CONFIG_PSA_CRYPTO=y
CONFIG_PSA_WANT_ALG_SHA_256=y
```

## nobt.conf
```kconfig
#
# The same program with the radio stack left out, for the one question
# it answers that the ordinary image cannot: a board that says nothing
# at all has either failed before MPSL, or in it.
#
CONFIG_BT=n
```

## src/audio.c
```c
/*
 * The i2s link with the RP2354, received as a slave - the RP2354 drives
 * both clocks.  It carries audio both ways, or the test pattern in
 * i2stest.h when there is none: from the pedal, what it sends to a phone
 * (source.c), and to it, what a phone or a broadcast sends (sink.c).  The
 * pattern is checked bit for bit, with a report once a second on the
 * debug stream.  Audio has the low byte of each word clear and the
 * pattern's right word never does, which tells the two apart per frame.
 */

#include <zephyr/kernel.h>
#include <zephyr/device.h>
#include <zephyr/drivers/i2s.h>
#include <zephyr/drivers/clock_control/nrf_clock_control.h>
#include <hal/nrf_i2s.h>
#include <hal/nrf_timer.h>
#include <helpers/nrfx_gppi.h>

#include "audio.h"
#include "sink.h"
#include "i2stest.h"

#define RATE		48000
#define BLOCK_FRAMES	256			/* 5.3 ms */
#define BLOCK_BYTES	(BLOCK_FRAMES * 2 * sizeof(int32_t))
#define BLOCKS		4

K_MEM_SLAB_DEFINE_STATIC(rx_slab, BLOCK_BYTES, BLOCKS, 4);
K_MEM_SLAB_DEFINE_STATIC(tx_slab, BLOCK_BYTES, BLOCKS, 4);

/* A block is a whole number of the pattern, so every block is the same */
BUILD_ASSERT(BLOCK_FRAMES % I2STEST_FRAMES == 0);

static const struct device *const i2s = DEVICE_DT_GET(DT_NODELABEL(i2s20));

static struct {
	bool running;
	struct i2stest_rx rx;	/* since the last report */
	uint32_t audio;		/* frames of audio, as against the pattern */
	uint32_t restarts;	/* nothing for a while: restarted */
	uint32_t block_at;	/* when a block last arrived */
	uint32_t reported_at;
} t;

/*
 * The pedal's frame rate, by this side's 32 MHz crystal.
 *
 * The i2s peripheral takes its next buffer at every block boundary, which
 * is exactly BLOCK_FRAMES of the pedal's frames, and that event is wired in
 * hardware to two timers: one captures a 16 MHz count, the other counts the
 * boundaries.  So the time of a boundary is known to a tick, with none of
 * the loop's lateness in it.  The high-frequency clock runs from the
 * crystal only while something asks for it, so this asks.
 */
#define MEASURE_CLOCK	0	/* a measurement: it holds the crystal on */

static NRF_TIMER_Type *const stamp = NRF_TIMER23;
static NRF_TIMER_Type *const bounds = NRF_TIMER24;
static struct onoff_client hfxo;

static struct {
	bool on, started;
	uint32_t n0;		/* boundaries at the first reading */
	uint32_t s_last;	/* the last capture, to unwrap the next */
	uint64_t ticks;		/* from the first reading's boundary */
	uint32_t n;		/* boundaries at the last reading */
} clk;

static void clock_start(void)
{
	nrfx_gppi_handle_t h;
	int err;

	sys_notify_init_spinwait(&hfxo.notify);
	err = onoff_request(z_nrf_clock_control_get_onoff(
				CLOCK_CONTROL_NRF_SUBSYS_HF), &hfxo);
	if (err < 0)
		printk("i2s: no crystal, %d\n", err);

	nrf_timer_mode_set(stamp, NRF_TIMER_MODE_TIMER);
	nrf_timer_bit_width_set(stamp, NRF_TIMER_BIT_WIDTH_32);
	nrf_timer_prescaler_set(stamp, 0);
	nrf_timer_mode_set(bounds, NRF_TIMER_MODE_COUNTER);
	nrf_timer_bit_width_set(bounds, NRF_TIMER_BIT_WIDTH_32);

	err = nrfx_gppi_conn_alloc(
		nrf_i2s_event_address_get(NRF_I2S20, NRF_I2S_EVENT_RXPTRUPD),
		nrf_timer_task_address_get(stamp, NRF_TIMER_TASK_CAPTURE0), &h);
	if (!err)
		err = nrfx_gppi_ep_attach(
			nrf_timer_task_address_get(bounds, NRF_TIMER_TASK_COUNT),
			h);
	if (err) {
		printk("i2s: no clock measurement, %d\n", err);
		return;
	}
	nrfx_gppi_conn_enable(h);
	nrf_timer_task_trigger(stamp, NRF_TIMER_TASK_START);
	nrf_timer_task_trigger(bounds, NRF_TIMER_TASK_START);
	clk.on = true;
}

/* The boundaries so far and when the last began, both of the same one */
static void clock_read(uint32_t *n, uint32_t *s)
{
	uint32_t again;

	do {
		nrf_timer_task_trigger(bounds, NRF_TIMER_TASK_CAPTURE0);
		*n = nrf_timer_cc_get(bounds, NRF_TIMER_CC_CHANNEL0);
		*s = nrf_timer_cc_get(stamp, NRF_TIMER_CC_CHANNEL0);
		nrf_timer_task_trigger(bounds, NRF_TIMER_TASK_CAPTURE0);
		again = nrf_timer_cc_get(bounds, NRF_TIMER_CC_CHANNEL0);
	} while (again != *n);
}

/*
 * Brought up to date once a second, which also unwraps the capture: it
 * wraps every 268 s at 16 MHz.  The answer is how far from 48 kHz the
 * pedal's frames are by this side's crystal, in parts per billion, and
 * the seconds it is averaged over.
 */
static bool clock_ppb(int64_t *ppb, uint32_t *secs)
{
	uint32_t n, s, f = NRF_TIMER_BASE_FREQUENCY_GET(stamp) >>
			     nrf_timer_prescaler_get(stamp);
	uint64_t frames;
	int64_t diff;

	if (!clk.on)
		return false;
	clock_read(&n, &s);
	if (!clk.started) {
		if (!n)
			return false;
		clk.n0 = clk.n = n;
		clk.s_last = s;
		clk.ticks = 0;
		clk.started = true;
		return false;
	}
	clk.ticks += (uint32_t)(s - clk.s_last);
	clk.s_last = s;
	clk.n = n;
	if (!clk.ticks)
		return false;

	frames = (uint64_t)(n - clk.n0) * BLOCK_FRAMES;
	diff = (int64_t)(frames * f) - (int64_t)(clk.ticks * RATE);
	*ppb = diff * 1000000 / (int64_t)(clk.ticks * RATE / 1000);
	*secs = clk.ticks / f;
	return true;
}

/*
 * Keep the transmit queue full: LE Audio while there is some, the test
 * pattern otherwise.  False if nothing went.
 */
static bool feed(void)
{
	bool fed = false;
	void *block;

	while (k_mem_slab_alloc(&tx_slab, &block, K_NO_WAIT) == 0) {
		int32_t *f = block;

		if (!sink_pcm(f, BLOCK_FRAMES))
			for (int i = 0; i < BLOCK_FRAMES; i++) {
				f[2 * i] = i2stest_left[i & I2STEST_MASK];
				f[2 * i + 1] = i2stest_right(i);
			}
		if (i2s_write(i2s, block, BLOCK_BYTES)) {
			k_mem_slab_free(&tx_slab, block);
			break;
		}
		fed = true;
	}
	return fed;
}

static void start(void)
{
	struct i2s_config cfg = {
		.word_size = 32,
		.channels = 2,
		.format = I2S_FMT_DATA_FORMAT_I2S,
		.options = I2S_OPT_BIT_CLK_TARGET | I2S_OPT_FRAME_CLK_TARGET,
		.frame_clk_freq = RATE,
		.mem_slab = &rx_slab,
		.block_size = BLOCK_BYTES,
		.timeout = 0,
	};
	int err;

	err = i2s_configure(i2s, I2S_DIR_RX, &cfg);
	if (!err) {
		cfg.mem_slab = &tx_slab;
		err = i2s_configure(i2s, I2S_DIR_TX, &cfg);
	}
	if (!err) {
		feed();
		err = i2s_trigger(i2s, I2S_DIR_BOTH, I2S_TRIGGER_START);
	}
	if (err) {
		printk("i2s: does not start, %d\n", err);
		return;
	}
	t.running = true;
	t.block_at = k_uptime_get_32();
}

void audio_start(void)
{
	if (!device_is_ready(i2s)) {
		printk("i2s: not ready\n");
		return;
	}
	i2stest_rx_init(&t.rx);
	t.reported_at = k_uptime_get_32();
	start();
	if (MEASURE_CLOCK)
		clock_start();
}

void audio_poll(void)
{
	void *block;
	size_t size;
	uint32_t now;

	if (!t.running)
		return;

	/*
	 * With no timeout, an empty queue is -EIO just as an error is, so
	 * the return says nothing.  What says the driver has stopped - an
	 * overrun does that - is no block for many blocks' time.
	 */
	while (i2s_read(i2s, &block, &size) == 0) {
		const int32_t *s = block;

		for (size_t i = 0; i + 1 < size / sizeof(int32_t); i += 2) {
			if ((s[i + 1] & 0xff) == 0xc3) {
				i2stest_check(&t.rx, s[i], s[i + 1]);
			} else {
				source_put(s[i], s[i + 1]);
				t.audio++;
			}
		}
		k_mem_slab_free(&rx_slab, block);
		t.block_at = k_uptime_get_32();
	}

	feed();

	now = k_uptime_get_32();
	if (now - t.block_at > 100) {
		t.restarts++;
		t.rx.phase = -1;
		clk.started = false;	/* the event count starts again */
		i2s_trigger(i2s, I2S_DIR_BOTH, I2S_TRIGGER_DROP);
		start();
	}

	uint32_t ms = now - t.reported_at;

	if (ms >= 1000) {
		printk("i2s: %u frames/s of audio, %u of the pattern, %s, "
		       "%u wrong (%u swapped, %u shifted), %u slips, "
		       "%u restarts\n",
		       (uint32_t)((uint64_t)t.audio * 1000 / ms),
		       (uint32_t)((uint64_t)t.rx.frames * 1000 / ms),
		       t.rx.phase >= 0 ? "in step" : "not in step",
		       t.rx.wrong, t.rx.swapped, t.rx.shifted, t.rx.slips,
		       t.restarts);

		int64_t ppb;
		uint32_t secs;

		if (clock_ppb(&ppb, &secs)) {
			int64_t a = ppb < 0 ? -ppb : ppb;

			printk("i2s: %s%lld.%03lld ppm from 48 kHz by this "
			       "crystal, over %u s\n", ppb < 0 ? "-" : "+",
			       a / 1000, a % 1000, secs);
		}
		t.rx.frames = t.rx.wrong = t.rx.swapped = t.rx.shifted = 0;
		t.rx.slips = t.restarts = t.audio = 0;
		t.reported_at = now;
	}
}
```

## src/audio.h
```c
#ifndef PEDAL_AUDIO_H
#define PEDAL_AUDIO_H

/* audio.c: the i2s link from the RP2354, started once and polled each pass */
void audio_start(void);
void audio_poll(void);

#endif /* PEDAL_AUDIO_H */
```

## src/bcast.c
```c
/*
 * An LE Audio broadcast sink: find a broadcast, sync to it, and pass its
 * LC3 frames to sink.c.
 *
 * Exploratory, after Zephyr's bap_broadcast_sink sample with everything
 * this does not use taken out - no Broadcast Assistant, no USB, no
 * encrypted broadcasts.  Finding and syncing is a chain of callbacks, each
 * of which notes what happened and leaves the next step to step_work on
 * the system work queue.
 */

#include <string.h>
#include <zephyr/kernel.h>
#include <zephyr/bluetooth/bluetooth.h>
#include <zephyr/bluetooth/gap.h>
#include <zephyr/bluetooth/iso.h>
#include <zephyr/bluetooth/uuid.h>
#include <zephyr/bluetooth/audio/audio.h>
#include <zephyr/bluetooth/audio/bap.h>
#include <zephyr/sys/byteorder.h>

#include "sink.h"
#include "scan.h"

#define CHANNELS	2

/* ------------------------------------------------------------------ */
/* Finding and syncing                                                 */
/* ------------------------------------------------------------------ */

static struct bt_bap_stream streams[CHANNELS];
static struct bt_bap_stream *stream_ptrs[CHANNELS] = { &streams[0],
							&streams[1] };

static struct {
	bool scanning;
	bool found;		/* a broadcast to sync to */
	bt_addr_le_t addr;
	uint8_t sid;
	uint16_t interval;
	uint32_t id;
	struct bt_le_per_adv_sync *pa;
	bool pa_synced;
	struct bt_bap_broadcast_sink *sink;
	uint32_t bis;		/* the BIS indexes to sync to */
	bool syncable;
	bool syncing;
	bool lost;		/* something ended: start again */
	int streams_up;
} b;

static void step(struct k_work *work);
static K_WORK_DEFINE(step_work, step);

static void kick(void)
{
	k_work_submit(&step_work);
}

/*
 * Not looking while a phone streams, or while headphones are wanted: a
 * scan takes the radio's receiver away from a phone's stream, and while
 * one runs, Zephyr will not start a connection at all.  One bit for each
 * reason, so that one ending does not end the other.
 */
static atomic_t paused;

void bcast_pause(unsigned int why, bool pause)
{
	if (pause)
		atomic_or(&paused, why);
	else
		atomic_and(&paused, ~why);
	kick();
}

static bool announcement(struct bt_data *data, void *user_data)
{
	const struct bt_le_scan_recv_info *info = user_data;
	struct bt_uuid_16 uuid;

	if (data->type != BT_DATA_SVC_DATA16 ||
	    data->data_len < BT_UUID_SIZE_16 + BT_AUDIO_BROADCAST_ID_SIZE)
		return true;
	if (!bt_uuid_create(&uuid.uuid, data->data, BT_UUID_SIZE_16) ||
	    bt_uuid_cmp(&uuid.uuid, BT_UUID_BROADCAST_AUDIO))
		return true;

	if (b.scanning && !b.found) {
		bt_addr_le_copy(&b.addr, info->addr);
		b.sid = info->sid;
		b.interval = info->interval;
		b.id = sys_get_le24(data->data + BT_UUID_SIZE_16);
		b.found = true;
		kick();
	}
	return false;
}

static void scan_recv(const struct bt_le_scan_recv_info *info,
		      struct net_buf_simple *ad)
{
	/* A periodic advertiser is the only kind that can be a broadcast */
	if (info->interval && b.scanning && !b.found)
		bt_data_parse(ad, announcement, (void *)info);
}

static struct bt_le_scan_cb scan_cb = { .recv = scan_recv };

static void pa_synced(struct bt_le_per_adv_sync *sync,
		      struct bt_le_per_adv_sync_synced_info *info)
{
	if (sync == b.pa) {
		b.pa_synced = true;
		kick();
	}
}

static void pa_term(struct bt_le_per_adv_sync *sync,
		    const struct bt_le_per_adv_sync_term_info *info)
{
	if (sync == b.pa) {
		printk("bcast: periodic sync lost, reason 0x%02x\n",
		       info->reason);
		b.pa = NULL;
		b.lost = true;
		kick();
	}
}

static struct bt_le_per_adv_sync_cb pa_cb = {
	.synced = pa_synced,
	.term = pa_term,
};

static void base_recv(struct bt_bap_broadcast_sink *sink,
		      const struct bt_bap_base *base, size_t size)
{
	uint32_t bis = 0;

	if (b.bis || bt_bap_base_get_bis_indexes(base, &bis) || !bis)
		return;

	/* The first two, which a stereo broadcast has as left and right */
	b.bis = bis & -bis;
	bis &= ~b.bis;
	b.bis |= bis & -bis;
	kick();
}

static void syncable(struct bt_bap_broadcast_sink *sink,
		     const struct bt_iso_biginfo *biginfo)
{
	/* How much of each interval the broadcast keeps the radio busy */
	printk("bcast: %u BIS, %u subevents each, burst %u, repeats %u, "
	       "PDU %u, interval %u us, PHY %u\n", biginfo->num_bis,
	       biginfo->sub_evt_count, biginfo->burst_number,
	       biginfo->rep_count, biginfo->max_pdu,
	       biginfo->iso_interval * 1250, biginfo->phy);
	if (biginfo->encryption) {
		printk("bcast: encrypted, which this does not do\n");
		return;
	}
	b.syncable = true;
	kick();
}

static void sink_started(struct bt_bap_broadcast_sink *sink)
{
	printk("bcast: synced to broadcast 0x%06x\n", b.id);
}

static void sink_stopped(struct bt_bap_broadcast_sink *sink, uint8_t reason)
{
	printk("bcast: stopped, reason 0x%02x\n", reason);
	b.lost = true;
	kick();
}

static struct bt_bap_broadcast_sink_cb sink_cb = {
	.base_recv = base_recv,
	.syncable = syncable,
	.started = sink_started,
	.stopped = sink_stopped,
};

static uint16_t sync_timeout(uint16_t interval)
{
	uint32_t timeout;

	if (interval == BT_BAP_PA_INTERVAL_UNKNOWN)
		return BT_GAP_PER_ADV_MAX_TIMEOUT;
	timeout = BT_GAP_US_TO_PER_ADV_SYNC_TIMEOUT(
			BT_GAP_PER_ADV_INTERVAL_TO_US(interval)) * 5;
	return CLAMP(timeout, BT_GAP_PER_ADV_MIN_TIMEOUT,
		     BT_GAP_PER_ADV_MAX_TIMEOUT);
}

/*
 * The next thing to do, from whatever the callbacks have said.  On the
 * system work queue, where the Bluetooth calls may wait.
 */
static void step(struct k_work *work)
{
	int err;

	if (atomic_get(&paused) && (b.scanning || b.found || b.pa || b.sink))
		b.lost = true;
	if (b.lost) {
		if (b.sink) {
			bt_bap_broadcast_sink_stop(b.sink);
			bt_bap_broadcast_sink_delete(b.sink);
		}
		if (b.pa)
			bt_le_per_adv_sync_delete(b.pa);
		if (b.scanning)
			scan_release();
		memset(&b, 0, sizeof(b));
	}
	if (atomic_get(&paused))
		return;

	if (!b.scanning && !b.found) {
		err = scan_hold();
		if (err) {
			printk("bcast: cannot scan, %d\n", err);
			return;
		}
		b.scanning = true;
		printk("bcast: looking for a broadcast\n");
		return;
	}

	if (b.found && !b.pa) {
		struct bt_le_per_adv_sync_param p = {
			.sid = b.sid,
			.skip = 5,
			.timeout = sync_timeout(b.interval),
		};

		scan_release();
		b.scanning = false;
		bt_addr_le_copy(&p.addr, &b.addr);
		printk("bcast: found broadcast 0x%06x, syncing\n", b.id);
		err = bt_le_per_adv_sync_create(&p, &b.pa);
		if (err) {
			printk("bcast: periodic sync failed, %d\n", err);
			b.lost = true;
			kick();
		}
		return;
	}

	if (b.pa_synced && !b.sink) {
		err = bt_bap_broadcast_sink_create(b.pa, b.id, &b.sink);
		if (err) {
			printk("bcast: sink not created, %d\n", err);
			b.lost = true;
			kick();
		}
		return;
	}

	if (b.sink && b.bis && b.syncable && !b.syncing) {
		b.syncing = true;
		err = bt_bap_broadcast_sink_sync(b.sink, b.bis, stream_ptrs,
						 NULL);
		if (err) {
			printk("bcast: BIG sync failed, %d\n", err);
			b.lost = true;
			kick();
		}
	}
}

/*
 * Each connection's timing, logged because connections and a synced
 * broadcast compete for the radio.
 */
static void conn_timing(struct bt_conn *conn, const char *what)
{
	struct bt_conn_info info;

	if (bt_conn_get_info(conn, &info) || info.type != BT_CONN_TYPE_LE)
		return;
	printk("bcast: connection %s, interval %u us, latency %u, "
	       "timeout %u ms, %s\n", what, info.le.interval_us,
	       info.le.latency, info.le.timeout * 10,
	       info.role == BT_CONN_ROLE_PERIPHERAL ? "peripheral" : "central");
}

static void timing_connected(struct bt_conn *conn, uint8_t err)
{
	if (!err)
		conn_timing(conn, "made");
}

static void timing_updated(struct bt_conn *conn, uint16_t interval,
			   uint16_t latency, uint16_t timeout)
{
	conn_timing(conn, "updated");
}

BT_CONN_CB_DEFINE(bcast_conn_cb) = {
	.connected = timing_connected,
	.le_param_updated = timing_updated,
};

/* ------------------------------------------------------------------ */
/* Audio in                                                            */
/* ------------------------------------------------------------------ */

static int channel_of(struct bt_bap_stream *stream)
{
	return stream == &streams[1] ? 1 : 0;
}

static void stream_recv(struct bt_bap_stream *stream,
			const struct bt_iso_recv_info *info,
			struct net_buf *buf)
{
	bool ok = info->flags & BT_ISO_FLAGS_VALID;

	sink_put(SINK_BCAST, channel_of(stream), buf->data, ok ? buf->len : 0);
}

/*
 * One BIS is heard in both channels, two are left and right.  At 48 kHz,
 * taken as read: a broadcast at another rate would want its BASE read.
 */
static void streams_changed(void)
{
	sink_feeding(SINK_BCAST, !b.streams_up ? 0 :
				 b.streams_up == 1 ? 1 : 3, 48000);
}

static void stream_started(struct bt_bap_stream *stream)
{
	b.streams_up++;
	streams_changed();
}

static void stream_stopped(struct bt_bap_stream *stream, uint8_t reason)
{
	if (b.streams_up)
		b.streams_up--;
	streams_changed();
}

static struct bt_bap_stream_ops stream_ops = {
	.started = stream_started,
	.stopped = stream_stopped,
	.recv = stream_recv,
};

int bcast_start(void)
{
	static struct bt_bap_scan_delegator_cb delegator;
	int err;

	err = bt_bap_scan_delegator_register(&delegator);
	if (err)
		return err;
	bt_bap_broadcast_sink_register_cb(&sink_cb);
	bt_le_per_adv_sync_cb_register(&pa_cb);
	bt_le_scan_cb_register(&scan_cb);
	for (int i = 0; i < CHANNELS; i++)
		bt_bap_stream_cb_register(&streams[i], &stream_ops);
	kick();
	return 0;
}
```

## src/bcast.h
```c
#ifndef PEDAL_BCAST_H
#define PEDAL_BCAST_H

#include <stdbool.h>
#include <stdint.h>

/*
 * bcast.c: an LE Audio broadcast sink.  Started once Bluetooth is up, polled
 * from the main loop, and asked by audio.c for what to send the pedal.
 */
#ifdef CONFIG_BT
void bcast_start(void);
void bcast_poll(void);
bool bcast_pcm(int32_t *out, int frames);
#else
static inline void bcast_start(void) { }
static inline void bcast_poll(void) { }
static inline bool bcast_pcm(int32_t *out, int frames)
{
	(void)out;
	(void)frames;
	return false;
}
#endif

#endif /* PEDAL_BCAST_H */
```

## src/bind.c
```c
/*
 * The connection to a controller the player picked out of a scan.
 *
 * A footswitch is a BLE MIDI peripheral, so reaching one means being a
 * central: connect, find the MIDI characteristic, subscribe, and hand
 * what arrives to the same decoder a write from the web app goes
 * through.  It ends at midi_uart_send() either way, so the pedal cannot
 * tell the two apart and does not need to.
 *
 * One at a time, and it keeps trying.  A footswitch sleeps, goes out of
 * range and comes back, and nobody is going to open the app to say so.
 */

#include <zephyr/kernel.h>
#include <zephyr/bluetooth/bluetooth.h>
#include <zephyr/bluetooth/conn.h>
#include <zephyr/bluetooth/gatt.h>
#include <zephyr/bluetooth/uuid.h>

#include "bind.h"
#include "midi.h"

#ifdef CONFIG_BT_CENTRAL

/*
 * How long to wait for pairing before reading the table anyway.
 *
 * A controller that wants an encrypted link hangs up during discovery
 * if nothing asks for one, so the request goes out first.  A controller
 * that wants nothing of the sort never answers, and the SMP timeout is
 * thirty seconds, which is not a wait to hand a player.
 */
#define ENCRYPT_WAIT_MS		2500

/* A controller that is off is the ordinary case, not a failure. */
#define RETRY_MS		5000
#define CONNECT_TIMEOUT_MS	4000

static struct bt_uuid_128 midi_service =
	BT_UUID_INIT_128(BT_UUID_128_ENCODE(0x03b80e5a, 0xede8, 0x4b33,
					    0xa751, 0x6ce34ec4c700));
static struct bt_uuid_128 midi_char =
	BT_UUID_INIT_128(BT_UUID_128_ENCODE(0x7772e5db, 0x3868, 0x4112,
					    0xa1a9, 0xf2669d106bf3));

static bt_addr_le_t target;
static bool have_target;

static struct bt_conn *conn;
static struct bt_gatt_discover_params discover;
static struct bt_gatt_subscribe_params subscribe;
static uint16_t service_end;
static uint16_t write_handle;		/* the MIDI characteristic's value */

/*
 * How far the link to the bound device has got, and why it last failed:
 * a negative errno for a connection or a subscription Zephyr refused,
 * 1000 plus the reason encryption failed, 2000 plus a disconnect's
 * reason, and 3000 plus the reason a connection was not made.
 */
static uint8_t state;
static int last_err;

/*
 * The connection is dropped on the Bluetooth stack's thread and written to
 * from the main loop, so it is let go of under a lock and used under a
 * reference.
 */
static struct k_spinlock bind_lock;

static void bind_drop(void)
{
	k_spinlock_key_t key = k_spin_lock(&bind_lock);
	struct bt_conn *old = conn;

	conn = NULL;
	write_handle = 0;
	k_spin_unlock(&bind_lock, key);

	if (old)
		bt_conn_unref(old);
}

uint8_t bind_state(void)
{
	return state;
}

int bind_last_err(void)
{
	return last_err;
}
static bool discovering;

static void try_connect(struct k_work *work);
static K_WORK_DELAYABLE_DEFINE(retry_work, try_connect);

static void discover_service(void);

static void impatient(struct k_work *work)
{
	ARG_UNUSED(work);

	if (conn)
		discover_service();
}
static K_WORK_DELAYABLE_DEFINE(wait_work, impatient);

/* ------------------------------------------------------------------ */
/* What arrives once we are subscribed                                 */
/* ------------------------------------------------------------------ */

static uint8_t notified(struct bt_conn *c, struct bt_gatt_subscribe_params *p,
			const void *data, uint16_t len)
{
	if (!data) {
		/* The peer dropped the subscription. */
		p->value_handle = 0;
		return BT_GATT_ITER_STOP;
	}

	midi_ble_controller(c, data, len);
	return BT_GATT_ITER_CONTINUE;
}

/* ------------------------------------------------------------------ */
/* Finding the characteristic to subscribe to                          */
/* ------------------------------------------------------------------ */

static uint8_t found_ccc(struct bt_conn *c, const struct bt_gatt_attr *attr,
			 struct bt_gatt_discover_params *params)
{
	int err;

	if (!attr) {
		printk("bind: no CCC, cannot subscribe\n");
		bt_conn_disconnect(c, BT_HCI_ERR_REMOTE_USER_TERM_CONN);
		return BT_GATT_ITER_STOP;
	}

	subscribe.ccc_handle = attr->handle;
	subscribe.value = BT_GATT_CCC_NOTIFY;
	subscribe.notify = notified;

	err = bt_gatt_subscribe(c, &subscribe);
	if (err) {
		last_err = err;
		printk("bind: subscribe refused\n");
	} else {
		state |= BIND_SUBSCRIBED;
	}

	return BT_GATT_ITER_STOP;
}

static uint8_t found_char(struct bt_conn *c, const struct bt_gatt_attr *attr,
			  struct bt_gatt_discover_params *params)
{
	if (!attr) {
		printk("bind: no MIDI characteristic\n");
		bt_conn_disconnect(c, BT_HCI_ERR_REMOTE_USER_TERM_CONN);
		return BT_GATT_ITER_STOP;
	}

	subscribe.value_handle = bt_gatt_attr_value_handle(attr);
	write_handle = subscribe.value_handle;
	state |= BIND_FOUND;

	discover.uuid = BT_UUID_GATT_CCC;
	discover.func = found_ccc;
	discover.start_handle = subscribe.value_handle + 1;
	discover.end_handle = service_end;
	discover.type = BT_GATT_DISCOVER_DESCRIPTOR;

	if (bt_gatt_discover(c, &discover))
		bt_conn_disconnect(c, BT_HCI_ERR_REMOTE_USER_TERM_CONN);

	return BT_GATT_ITER_STOP;
}

static uint8_t found_service(struct bt_conn *c, const struct bt_gatt_attr *attr,
			     struct bt_gatt_discover_params *params)
{
	const struct bt_gatt_service_val *val;

	if (!attr) {
		printk("bind: no MIDI service on this device\n");
		bt_conn_disconnect(c, BT_HCI_ERR_REMOTE_USER_TERM_CONN);
		return BT_GATT_ITER_STOP;
	}

	val = attr->user_data;
	service_end = val->end_handle;

	discover.uuid = &midi_char.uuid;
	discover.func = found_char;
	discover.start_handle = attr->handle + 1;
	discover.end_handle = service_end;
	discover.type = BT_GATT_DISCOVER_CHARACTERISTIC;

	if (bt_gatt_discover(c, &discover))
		bt_conn_disconnect(c, BT_HCI_ERR_REMOTE_USER_TERM_CONN);

	return BT_GATT_ITER_STOP;
}

static void discover_service(void)
{
	if (discovering)
		return;
	discovering = true;

	discover.uuid = &midi_service.uuid;
	discover.func = found_service;
	discover.start_handle = BT_ATT_FIRST_ATTRIBUTE_HANDLE;
	discover.end_handle = BT_ATT_LAST_ATTRIBUTE_HANDLE;
	discover.type = BT_GATT_DISCOVER_PRIMARY;

	if (bt_gatt_discover(conn, &discover))
		bt_conn_disconnect(conn, BT_HCI_ERR_REMOTE_USER_TERM_CONN);
}

/* ------------------------------------------------------------------ */
/* Getting there, and staying there                                    */
/* ------------------------------------------------------------------ */

static void try_connect(struct k_work *work)
{
	struct bt_conn_le_create_param create =
		BT_CONN_LE_CREATE_PARAM_INIT(BT_CONN_LE_OPT_NONE,
					     BT_GAP_SCAN_FAST_INTERVAL,
					     BT_GAP_SCAN_FAST_WINDOW);
	int err;

	ARG_UNUSED(work);

	if (!have_target || conn)
		return;

	create.timeout = CONNECT_TIMEOUT_MS / 10;

	err = bt_conn_le_create(&target, &create, BT_LE_CONN_PARAM_DEFAULT,
				&conn);
	if (err) {
		last_err = err;
		k_work_schedule(&retry_work, K_MSEC(RETRY_MS));
	}
}

void bind_to(const bt_addr_le_t *addr)
{
	bt_addr_le_copy(&target, addr);
	have_target = true;

	if (conn) {
		/* Drop whatever we were on; the retry picks up the new one. */
		bt_conn_disconnect(conn, BT_HCI_ERR_REMOTE_USER_TERM_CONN);
		return;
	}

	k_work_schedule(&retry_work, K_NO_WAIT);
}

bool bind_owns(struct bt_conn *c)
{
	return c && c == conn;
}

void bind_connected(struct bt_conn *c, uint8_t err)
{
	if (err) {
		last_err = 3000 + err;
		bind_drop();
		k_work_schedule(&retry_work, K_MSEC(RETRY_MS));
		return;
	}

	printk("bind: connected\n");
	state = BIND_CONNECTED;
	discovering = false;

	/*
	 * Ask for encryption and read the table a moment later whether or
	 * not it settled - see ENCRYPT_WAIT_MS.
	 */
	if (bt_conn_set_security(c, BT_SECURITY_L2))
		discover_service();
	else
		k_work_schedule(&wait_work, K_MSEC(ENCRYPT_WAIT_MS));
}

void bind_encrypted(struct bt_conn *c, bt_security_t level, int err)
{
	k_work_cancel_delayable(&wait_work);

	if (err)
		last_err = 1000 + err;
	else
		state |= BIND_ENCRYPTED;

	//
	// A key the other end has forgotten.  Pairing is kept in RAM
	// only, so a controller that has been reset - or a radio that
	// has been reflashed - leaves the two disagreeing about a bond,
	// and every connection after that fails to encrypt with "PIN or
	// key missing" instead of pairing again.
	//
	// Throw ours away and hang up.  The next attempt has nothing to
	// remember and pairs from the start.
	//
	if (err == BT_SECURITY_ERR_PIN_OR_KEY_MISSING) {
		printk("bind: stale key, forgetting it\n");
		bt_unpair(BT_ID_DEFAULT, &target);
		bt_conn_disconnect(c, BT_HCI_ERR_REMOTE_USER_TERM_CONN);
		return;
	}

	discover_service();
}

void bind_disconnected(struct bt_conn *c, uint8_t reason)
{
	printk("bind: disconnected, %u\n", reason);

	k_work_cancel_delayable(&wait_work);
	bind_drop();
	subscribe.value_handle = 0;
	state = 0;
	last_err = 2000 + reason;
	discovering = false;

	k_work_schedule(&retry_work, K_MSEC(RETRY_MS));
}

/*
 * MIDI to the bound device, as one BLE MIDI packet: a header byte, and a
 * timestamp before every status byte as RP-052 asks.  Written without a
 * response, which is what a MIDI characteristic offers.
 */
int bind_send(const uint8_t *midi, size_t len)
{
	uint8_t pkt[1 + 2 * BIND_SEND_MAX];
	uint16_t now = k_uptime_get_32() & 0x1FFF;
	struct bt_conn *c = NULL;
	uint16_t handle = 0;
	k_spinlock_key_t key;
	size_t n = 0;
	int err;

	if (len > BIND_SEND_MAX)
		return -EMSGSIZE;

	key = k_spin_lock(&bind_lock);
	if (conn && write_handle) {
		c = bt_conn_ref(conn);
		handle = write_handle;
	}
	k_spin_unlock(&bind_lock, key);
	if (!c)
		return -ENOTCONN;

	pkt[n++] = 0x80 | (now >> 7);
	for (size_t i = 0; i < len; i++) {
		if (midi[i] & 0x80)
			pkt[n++] = 0x80 | (now & 0x7F);
		pkt[n++] = midi[i];
	}

	err = bt_gatt_write_without_response(c, handle, pkt, n, false);
	bt_conn_unref(c);
	return err;
}

#endif /* CONFIG_BT_CENTRAL */
```

## src/bind.h
```c
#ifndef PEDAL_BIND_H
#define PEDAL_BIND_H

#include <stdint.h>
#include <stdbool.h>

#include <zephyr/bluetooth/bluetooth.h>
#include <zephyr/bluetooth/conn.h>

/*
 * The controller the player picked out of a scan.  Connecting to it,
 * subscribing to its MIDI characteristic, and reconnecting when it
 * comes back.
 */

#ifdef CONFIG_BT_CENTRAL

void bind_to(const bt_addr_le_t *addr);

/* MIDI bytes to the bound device; at most this many in one call */
#define BIND_SEND_MAX	8
int bind_send(const uint8_t *midi, size_t len);

#define BIND_CONNECTED	0x01
#define BIND_ENCRYPTED	0x02
#define BIND_FOUND	0x04
#define BIND_SUBSCRIBED	0x08
uint8_t bind_state(void);
int bind_last_err(void);

/*
 * Both roles share one set of connection callbacks, so midi.c asks
 * whose a connection is before treating it as the web app's.
 */
bool bind_owns(struct bt_conn *conn);
void bind_connected(struct bt_conn *conn, uint8_t err);
void bind_disconnected(struct bt_conn *conn, uint8_t reason);
void bind_encrypted(struct bt_conn *conn, bt_security_t level, int err);

#else

static inline bool bind_owns(struct bt_conn *conn) { return false; }
static inline uint8_t bind_state(void) { return 0; }
static inline int bind_last_err(void) { return 0; }

#endif /* CONFIG_BT_CENTRAL */

#endif /* PEDAL_BIND_H */
```

## src/i2stest.h
```c
/*
 * A test pattern for the i2s link between the RP2354 and the radio, which
 * both sides compile, the way they both compile link.h.
 *
 * 64 stereo frames, repeated for ever.  The left channel is a sine at half
 * of full scale, exactly one period of the 64, so 750 Hz at 48 kHz.  The
 * right is a word that names the frame, with bits set across the whole of
 * it.  A receiver checks every bit: a frame that matches with left and
 * right exchanged, or shifted by a bit, says what is wrong with the format
 * rather than only that something is.
 *
 * The sine is a table of integers rather than sinf(), because the two
 * sides build against different C libraries and a difference in the last
 * bit would read as a fault on the link.
 */
#ifndef I2STEST_H
#define I2STEST_H

#include <stdint.h>

#define I2STEST_SHIFT	6
#define I2STEST_FRAMES	(1 << I2STEST_SHIFT)
#define I2STEST_MASK	(I2STEST_FRAMES - 1)

static const int32_t i2stest_left[I2STEST_FRAMES] = {
	0, 105245103, 209476638, 311690799,
	410903207, 506158392, 596538995, 681174602,
	759250125, 830013654, 892783698, 946955747,
	992008094, 1027506862, 1053110176, 1068571464,
	1073741824, 1068571464, 1053110176, 1027506862,
	992008094, 946955747, 892783698, 830013654,
	759250125, 681174602, 596538995, 506158392,
	410903207, 311690799, 209476638, 105245103,
	0, -105245103, -209476638, -311690799,
	-410903207, -506158392, -596538995, -681174602,
	-759250125, -830013654, -892783698, -946955747,
	-992008094, -1027506862, -1053110176, -1068571464,
	-1073741824, -1068571464, -1053110176, -1027506862,
	-992008094, -946955747, -892783698, -830013654,
	-759250125, -681174602, -596538995, -506158392,
	-410903207, -311690799, -209476638, -105245103,
};

static inline int32_t i2stest_right(unsigned int frame)
{
	frame &= I2STEST_MASK;
	return (int32_t)(0x5A000000u | frame << 16 |
			 (~frame & I2STEST_MASK) << 8 | 0xC3);
}

#endif /* I2STEST_H */
```

## src/linktest.h
```c
/*
 * A load for testing the link (link.h) itself, which both sides run.
 *
 * Each side sends a number of test streams at once, and checks every test
 * packet it receives: each carries its stream and a counter, and its length
 * and contents follow from those two, zero bytes included so that COBS has
 * something to do.  One stream can be made stuck: its receiver holds the
 * packets without consuming them for a while, so that stream's window stays
 * shut while everything else - the other test streams, commands, debug text
 * and real MIDI - has to keep moving.
 *
 * The radio's loop can also be stopped once, a second into the run, so
 * that the pedal's bytes pile up in its receive ring meanwhile.
 *
 * The pedal starts a run and asks for the radio's counts on test stream 0,
 * which is the stream used to talk about the test rather than to load it.
 */
#ifndef LINKTEST_H
#define LINKTEST_H

#include "link.h"

#define LINKTEST_STREAMS	4

/* What goes on test stream 0, by its first byte */
#define LINKTEST_START	1	/* the settings, as linktest_cfg_pack() */
#define LINKTEST_ASK	2	/* please send your counts */
#define LINKTEST_COUNTS	3	/* the counts, as linktest_counts_pack() */

struct linktest_cfg {
	uint8_t streams;	/* test streams each way, 1 to LINKTEST_STREAMS */
	uint16_t count;		/* packets on each */
	uint8_t stuck;		/* the stream whose receiver holds, or 0xff */
	uint16_t stuck_ms;	/* for how long from the start */
	uint16_t lines;		/* debug lines the radio prints meanwhile */
	uint16_t stall_ms;	/* how long the radio's loop stops, or 0 */
};

struct linktest {
	struct linktest_cfg cfg;
	bool running;
	uint32_t started;

	uint16_t sent[LINKTEST_STREAMS];	/* packets sent on each */
	uint16_t next[LINKTEST_STREAMS];	/* counter expected next */
	uint32_t got, bad, lost, early;		/* received: fine, wrong, */
						/* missing, and repeated */
	bool holding;				/* stuck packets unconsumed */
	uint8_t held_seq;
	uint32_t held;				/* how many were held */
	uint16_t lines;				/* lines still to print */
	uint8_t turn;				/* round-robin over streams */
	bool stalled;				/* the radio's loop has stopped */
};

static inline void linktest_start(struct linktest *t,
				  const struct linktest_cfg *cfg, uint32_t now)
{
	*t = (struct linktest){ .cfg = *cfg, .running = true, .started = now,
				.lines = cfg->lines };
	if (t->cfg.streams > LINKTEST_STREAMS)
		t->cfg.streams = LINKTEST_STREAMS;
}

/* Seven bits a byte, because the pedal takes the settings over SysEx */
static inline size_t linktest_cfg_pack(const struct linktest_cfg *c,
				       uint8_t *out)
{
	const uint8_t b[] = {
		LINKTEST_START, c->streams, c->count & 0x7f, c->count >> 7,
		c->stuck, c->stuck_ms & 0x7f, c->stuck_ms >> 7,
		c->lines & 0x7f, c->lines >> 7,
		c->stall_ms & 0x7f, c->stall_ms >> 7,
	};

	for (size_t i = 0; i < sizeof(b); i++)
		out[i] = b[i];
	return sizeof(b);
}

static inline bool linktest_cfg_unpack(const uint8_t *in, size_t len,
				       struct linktest_cfg *c)
{
	if (len < 9 || in[0] != LINKTEST_START)
		return false;
	c->streams = in[1];
	c->count = in[2] | in[3] << 7;
	c->stuck = in[4] == 0x7f ? 0xff : in[4];
	c->stuck_ms = in[5] | in[6] << 7;
	c->lines = in[7] | in[8] << 7;
	c->stall_ms = len >= 11 ? in[9] | in[10] << 7 : 0;
	return true;
}

#define LINKTEST_COUNTS_LEN	(1 + 2 * LINKTEST_STREAMS + 4 * 5)

static inline void linktest_put32(uint8_t *out, uint32_t v)
{
	out[0] = v;
	out[1] = v >> 8;
	out[2] = v >> 16;
	out[3] = v >> 24;
}

static inline uint32_t linktest_get32(const uint8_t *in)
{
	return in[0] | in[1] << 8 | in[2] << 16 | (uint32_t)in[3] << 24;
}

static inline size_t linktest_counts_pack(const struct linktest *t,
					  uint8_t *out)
{
	size_t n = 0;

	out[n++] = LINKTEST_COUNTS;
	for (int i = 0; i < LINKTEST_STREAMS; i++) {
		out[n++] = t->sent[i];
		out[n++] = t->sent[i] >> 8;
	}
	linktest_put32(out + n, t->got), n += 4;
	linktest_put32(out + n, t->bad), n += 4;
	linktest_put32(out + n, t->lost), n += 4;
	linktest_put32(out + n, t->early), n += 4;
	linktest_put32(out + n, t->held), n += 4;
	return n;
}

static inline bool linktest_counts_unpack(const uint8_t *in, size_t len,
					  struct linktest *t)
{
	size_t n = 1;

	if (len < LINKTEST_COUNTS_LEN || in[0] != LINKTEST_COUNTS)
		return false;
	for (int i = 0; i < LINKTEST_STREAMS; i++, n += 2)
		t->sent[i] = in[n] | in[n + 1] << 8;
	t->got = linktest_get32(in + n), n += 4;
	t->bad = linktest_get32(in + n), n += 4;
	t->lost = linktest_get32(in + n), n += 4;
	t->early = linktest_get32(in + n), n += 4;
	t->held = linktest_get32(in + n);
	return true;
}

/* A test packet's payload, from its stream and counter */
static inline size_t linktest_fill(uint8_t stream, uint16_t cnt, uint8_t *out)
{
	size_t len = 3 + (cnt * 7u + stream * 13u) % (LINK_PAYLOAD_MAX - 2);

	out[0] = stream;
	out[1] = cnt;
	out[2] = cnt >> 8;
	for (size_t j = 3; j < len; j++)
		out[j] = (uint8_t)(cnt + j * 31 + stream);
	return len;
}

/*
 * The next test packet this side may send: which stream, ready in 'out',
 * or -1 if none.
 */
static inline int linktest_next(struct linktest *t, struct link *l,
				uint8_t *out, size_t *len)
{
	if (!t->running)
		return -1;
	for (int k = 0; k < t->cfg.streams; k++) {
		int i = (t->turn + k) % t->cfg.streams;

		if (t->sent[i] < t->cfg.count &&
		    link_can_send(l, LINK_TEST, i + 1)) {
			*len = linktest_fill(i, t->sent[i]++, out);
			t->turn = i + 1;
			return i;
		}
	}
	return -1;
}

/*
 * A test packet that has arrived: checked and counted.  Returns false if
 * it is to be held rather than consumed, because it is on the stuck stream
 * and the stuck time has not run out.
 */
static inline bool linktest_got(struct linktest *t, uint8_t seq,
				const uint8_t *p, size_t len, uint32_t now)
{
	uint8_t want[LINK_PAYLOAD_MAX];
	uint16_t cnt;
	uint8_t s;

	if (len < 3 || p[0] >= LINKTEST_STREAMS) {
		t->bad++;
		return true;
	}
	s = p[0];
	cnt = p[1] | p[2] << 8;
	if (linktest_fill(s, cnt, want) != len) {
		t->bad++;
	} else {
		for (size_t j = 0; j < len; j++)
			if (want[j] != p[j]) {
				t->bad++;
				goto counted;
			}
		if (cnt > t->next[s])
			t->lost += cnt - t->next[s];
		else if (cnt < t->next[s])
			t->early++;
		t->got++;
	}
counted:
	if (cnt >= t->next[s])
		t->next[s] = cnt + 1;

	if (s == t->cfg.stuck && now - t->started < t->cfg.stuck_ms) {
		t->holding = true;
		t->held_seq = seq;
		t->held++;
		return false;
	}
	// Consuming this one acknowledges whatever was held before it
	if (s == t->cfg.stuck)
		t->holding = false;
	return true;
}

/* Consume what the stuck stream held, once its time is up */
static inline void linktest_release(struct linktest *t, struct link *l,
				    uint32_t now)
{
	if (t->holding && now - t->started >= t->cfg.stuck_ms) {
		link_done(l, LINK_TEST, t->cfg.stuck + 1, t->held_seq);
		t->holding = false;
	}
}

#endif /* LINKTEST_H */
```
